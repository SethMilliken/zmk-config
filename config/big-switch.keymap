// HEADERS {{{
#include <behaviors.dtsi>
#include <dt-bindings/zmk/keys.h>
#include <dt-bindings/zmk/outputs.h>
#include <dt-bindings/zmk/bt.h>
#include <dt-bindings/zmk/rgb.h>
#include <dt-bindings/zmk/ext_power.h>

// }}}
/ {
// KEYMAP {{{
// n.b. label strings are truncated after 8 characters
    keymap {
        compatible = "zmk,keymap";

        /* 0 Layer */
        default {
            label = "araxia";
            bindings = <
 &kp N1
            >;
            sensor-bindings = <&inc_dec_kp C_VOL_UP C_VOL_DN>;
        };

    };

};
// }}}
/* vim: set ft=dts: */
