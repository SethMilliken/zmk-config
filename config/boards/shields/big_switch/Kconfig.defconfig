## config/west.yml
```yaml
manifest:
  remotes:
    - name: zmkfirmware
      url-base: https://github.com/zmkfirmware
    - name: SethMilliken
      url-base: https://github.com/SethMilliken
    - name: caksoylar
      url-base: https://github.com/caksoylar
    - name: dhruvinsh
      url-base: https://github.com/dhruvinsh
    - name: davidphilipbarr
      url-base: https://github.com/davidphilipbarr
  projects:
    - name: zmk
      #remote: zmkfirmware
      #revision: main
      remote: SethMilliken
      revision: zen-display-patches                # custom branch name
      #remote: caksoylar
      #revision: caksoylar/zen-v1+v2+experimental  # custom branch name
      clone-depth: 1
      import: app/west.yml
    - name: zmk-tri-state
      remote: dhruvinsh
      clone-depth: 1
      revision: main
    - name: nicehatharry
      remote: SethMilliken
      clone-depth: 1
      revision: main
  self:
    path: config
```
